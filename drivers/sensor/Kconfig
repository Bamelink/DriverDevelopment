## drivers/sensor/examplesensor/Kconfig
```kconfig
config EXAMPLESENSOR
	bool "Example sensor"
	default y
	depends on GPIO && DT_HAS_ZEPHYR_EXAMPLESENSOR_ENABLED
	help
	  Enable example sensor
```

## ledcontroller/zephyr/Kconfig
```kconfig
# Copyright (c) 2019 Nordic Semiconductor
# SPDX-License-Identifier: Apache-2.0

config LEDCONTROLLER
	bool "Support for the demonstration out of tree driver"
```
